## kernel/FjFeat/Kconfig
```kconfig
comment "--------------------------------------------------------"
comment "COPYRIGHT(C) FUJITSU TEN LIMITED 2012                   "
comment "--------------------------------------------------------"

config FJFEAT_PRODUCT_ADA3S
	bool "FJFEAT_PRODUCT_ADA3S"

config FJFEAT_PRODUCT_ADA1M
	bool "FJFEAT_PRODUCT_ADA1M"

config FJFEAT_PRODUCT_ADA2S
	bool "FJFEAT_PRODUCT_ADA2S"

config FJFEAT_PRODUCT_ADA1S
	bool "FJFEAT_PRODUCT_ADA1S"

config FJFEAT_PRODUCT_BRANDYK
	bool "FJFEAT_PRODUCT_BRANDYK"

config FJFEAT_PRODUCT_IRUKAD
	bool "FJFEAT_PRODUCT_IRUKAD"

config FJFEAT_PRODUCT_LYCHEE
	bool "FJFEAT_PRODUCT_LYCHEE"

config FJFEAT_PRODUCT_BACURAJW
	bool "FJFEAT_PRODUCT_BACURAJW"

config FJFEAT_PRODUCT_BACURA
	bool "FJFEAT_PRODUCT_BACURA"

config FJFEAT_PRODUCT_NADESHIKO
	bool "FJFEAT_PRODUCT_NADESHIKO"

config FJFEAT_PRODUCT_SWORDFISH
	bool "FJFEAT_PRODUCT_SWORDFISH"

config FJFEAT_PRODUCT_ACEROLA
	bool "FJFEAT_PRODUCT_ACEROLA"

config FJFEAT_PRODUCT_GENERIC_12F_8X55
	bool "FJFEAT_PRODUCT_GENERIC_12F_8X55"

config FJFEAT_PRODUCT_ARCHERYK
	bool "FJFEAT_PRODUCT_ARCHERYK"

config FJFEAT_PRODUCT_ARCHERYD
	bool "FJFEAT_PRODUCT_ARCHERYD"

config FJFEAT_PRODUCT_TATOOINES
	bool "FJFEAT_PRODUCT_TATOOINES"

config FJFEAT_PRODUCT_TATOOINED
	bool "FJFEAT_PRODUCT_TATOOINED"

config FJFEAT_PRODUCT_GENERIC_12F_TEGRA3
	bool "FJFEAT_PRODUCT_GENERIC_12F_TEGRA3"

config FJFEAT_PRODUCT_GENERIC_12F_8960
	bool "FJFEAT_PRODUCT_GENERIC_12F_8960"

config FJFEAT_PRODUCT_ICS_NEXTI
	bool "FJFEAT_PRODUCT_ICS_NEXTI"

config FJFEAT_PRODUCT_APOLLOK
	bool "FJFEAT_PRODUCT_APOLLOK"

config FJFEAT_PRODUCT_APOLLOD
	bool "FJFEAT_PRODUCT_APOLLOD"

config FJFEAT_PRODUCT_BIGBEN
	bool "FJFEAT_PRODUCT_BIGBEN"

config FJFEAT_PRODUCT_SKYTREE
	bool "FJFEAT_PRODUCT_SKYTREE"

config FJFEAT_PRODUCT_TRIUMPH
	bool "FJFEAT_PRODUCT_TRIUMPH"

config FJFEAT_PRODUCT_SHARD
	bool "FJFEAT_PRODUCT_SHARD"

choice
	prompt  "MACRO" 
	default FJFEAT_CARRIER_OTHER

config FJFEAT_CARRIER_SOFTBANK
	bool "FJFEAT_CARRIER_SOFTBANK"

config FJFEAT_CARRIER_KDDI
	bool "FJFEAT_CARRIER_KDDI"

config FJFEAT_CARRIER_DOCOMO
	bool "FJFEAT_CARRIER_DOCOMO"

config FJFEAT_CARRIER_OTHER
	bool "FJFEAT_CARRIER_OTHER"

endchoice


choice
	prompt  "MACRO" 
	default FJFEAT_PLATFORM_TEGRA

config FJFEAT_PLATFORM_TEGRA
	bool "FJFEAT_PLATFORM_TEGRA"

config FJFEAT_PLATFORM_OMAP
	bool "FJFEAT_PLATFORM_OMAP"

config FJFEAT_PLATFORM_QUALCOMM
	bool "FJFEAT_PLATFORM_QUALCOMM"

endchoice


choice
	prompt  "MACRO" 
	default FJFEAT_OS_ICECREAMSANDWICH

config FJFEAT_OS_ICECREAMSANDWICH
	bool "FJFEAT_OS_ICECREAMSANDWICH"

config FJFEAT_OS_GINGERBREAD
	bool "FJFEAT_OS_GINGERBREAD"

endchoice

config FJFEAT_ADA_KERN_LOG_NOTICE
	bool "FJFEAT_ADA_KERN_LOG_NOTICE"

config FJFEAT_ADA_KERN_LOG_INFO
	bool "FJFEAT_ADA_KERN_LOG_INFO"

config FJFEAT_ADA_KERN_LOG_DEBUG
	bool "FJFEAT_ADA_KERN_LOG_DEBUG"

config FJFEAT_ADA_KERN_LOG_TRACE
	bool "FJFEAT_ADA_KERN_LOG_TRACE"

config FJFEAT_ADA_OPROFILE_PMU_INITIALIZE
	bool "FJFEAT_ADA_OPROFILE_PMU_INITIALIZE"
```

## kernel/arch/arm/configs/tegra_p852_gnu_linux_minimal_defconfig
```kconfig
CONFIG_EXPERIMENTAL=y
# CONFIG_LOCALVERSION_AUTO is not set
# CONFIG_SWAP is not set
CONFIG_SYSVIPC=y
CONFIG_POSIX_MQUEUE=y
CONFIG_AUDIT=y
CONFIG_IKCONFIG=y
CONFIG_IKCONFIG_PROC=y
CONFIG_CGROUPS=y
CONFIG_CGROUP_DEBUG=y
CONFIG_CGROUP_FREEZER=y
CONFIG_CGROUP_DEVICE=y
CONFIG_CGROUP_CPUACCT=y
CONFIG_RESOURCE_COUNTERS=y
CONFIG_CGROUP_MEM_RES_CTLR=y
CONFIG_CGROUP_SCHED=y
CONFIG_RT_GROUP_SCHED=y
CONFIG_BLK_CGROUP=y
CONFIG_BLK_DEV_INITRD=y
# CONFIG_RD_GZIP is not set
CONFIG_PANIC_TIMEOUT=10
CONFIG_ASHMEM=y
CONFIG_EMBEDDED=y
CONFIG_SLAB=y
CONFIG_MODULES=y
CONFIG_MODULE_UNLOAD=y
CONFIG_MODULE_FORCE_UNLOAD=y
# CONFIG_BLK_DEV_BSG is not set
# CONFIG_IOSCHED_DEADLINE is not set
CONFIG_CFQ_GROUP_IOSCHED=y
CONFIG_ARCH_TEGRA=y
CONFIG_MACH_P852=y
CONFIG_TEGRA_PWM=y
# CONFIG_TEGRA_CPU_DVFS is not set
CONFIG_NON_ALIASED_COHERENT_MEM=y
CONFIG_NO_HZ=y
CONFIG_HIGH_RES_TIMERS=y
CONFIG_SMP=y
CONFIG_VMSPLIT_2G=y
CONFIG_NR_CPUS=2
CONFIG_PREEMPT=y
CONFIG_AEABI=y
# CONFIG_OABI_COMPAT is not set
CONFIG_HIGHMEM=y
CONFIG_ZBOOT_ROM_TEXT=0x0
CONFIG_ZBOOT_ROM_BSS=0x0
CONFIG_CMDLINE="mem=448M@0M console=ttyS0,115200n8 earlyprintk init=/bin/ash"
CONFIG_VFP=y
# CONFIG_SUSPEND is not set
CONFIG_NET=y
CONFIG_PACKET=y
CONFIG_UNIX=y
CONFIG_NET_KEY=y
CONFIG_INET=y
CONFIG_IP_MULTICAST=y
CONFIG_IP_ADVANCED_ROUTER=y
CONFIG_IP_MULTIPLE_TABLES=y
CONFIG_IP_ROUTE_MULTIPATH=y
CONFIG_IP_ROUTE_VERBOSE=y
CONFIG_IP_PNP=y
CONFIG_IP_PNP_DHCP=y
CONFIG_SYN_COOKIES=y
CONFIG_INET_ESP=y
# CONFIG_INET_XFRM_MODE_TUNNEL is not set
# CONFIG_INET_XFRM_MODE_BEET is not set
# CONFIG_INET_LRO is not set
# CONFIG_INET_DIAG is not set
CONFIG_IPV6=y
CONFIG_INET6_ESP=m
CONFIG_INET6_XFRM_MODE_TRANSPORT=m
CONFIG_INET6_XFRM_MODE_TUNNEL=m
CONFIG_INET6_XFRM_MODE_BEET=m
CONFIG_IPV6_SIT=m
CONFIG_IPV6_MULTIPLE_TABLES=y
# CONFIG_ANDROID_PARANOID_NETWORK is not set
CONFIG_NETFILTER=y
CONFIG_NETFILTER_NETLINK_LOG=m
CONFIG_NF_CONNTRACK=m
CONFIG_NF_CONNTRACK_EVENTS=y
CONFIG_NF_CT_PROTO_DCCP=m
CONFIG_NF_CT_PROTO_SCTP=m
CONFIG_NF_CT_PROTO_UDPLITE=m
CONFIG_NF_CONNTRACK_AMANDA=m
CONFIG_NF_CONNTRACK_FTP=m
CONFIG_NF_CONNTRACK_H323=m
CONFIG_NF_CONNTRACK_IRC=m
CONFIG_NF_CONNTRACK_NETBIOS_NS=m
CONFIG_NF_CONNTRACK_PPTP=m
CONFIG_NF_CONNTRACK_SANE=m
CONFIG_NF_CONNTRACK_SIP=m
CONFIG_NF_CONNTRACK_TFTP=m
CONFIG_NF_CT_NETLINK=m
CONFIG_NETFILTER_XT_TARGET_CLASSIFY=m
CONFIG_NETFILTER_XT_TARGET_CONNMARK=m
CONFIG_NETFILTER_XT_TARGET_MARK=m
CONFIG_NETFILTER_XT_TARGET_NFQUEUE=m
CONFIG_NETFILTER_XT_MATCH_COMMENT=y
CONFIG_NETFILTER_XT_MATCH_CONNBYTES=m
CONFIG_NETFILTER_XT_MATCH_CONNLIMIT=m
CONFIG_NETFILTER_XT_MATCH_CONNMARK=m
CONFIG_NETFILTER_XT_MATCH_CONNTRACK=m
CONFIG_NETFILTER_XT_MATCH_HASHLIMIT=m
CONFIG_NETFILTER_XT_MATCH_HELPER=m
CONFIG_NETFILTER_XT_MATCH_IPRANGE=m
CONFIG_NETFILTER_XT_MATCH_LENGTH=m
CONFIG_NETFILTER_XT_MATCH_LIMIT=m
CONFIG_NETFILTER_XT_MATCH_MAC=m
CONFIG_NETFILTER_XT_MATCH_MARK=m
CONFIG_NETFILTER_XT_MATCH_OWNER=m
CONFIG_NETFILTER_XT_MATCH_POLICY=m
CONFIG_NETFILTER_XT_MATCH_PKTTYPE=m
CONFIG_NETFILTER_XT_MATCH_QUOTA=m
CONFIG_NETFILTER_XT_MATCH_STATE=m
CONFIG_NETFILTER_XT_MATCH_STATISTIC=m
CONFIG_NETFILTER_XT_MATCH_STRING=m
CONFIG_NETFILTER_XT_MATCH_TIME=m
CONFIG_NETFILTER_XT_MATCH_U32=m
CONFIG_NF_CONNTRACK_IPV4=m
CONFIG_IP_NF_QUEUE=y
CONFIG_IP_NF_IPTABLES=y
CONFIG_IP_NF_MATCH_AH=y
CONFIG_IP_NF_MATCH_ECN=y
CONFIG_IP_NF_MATCH_TTL=y
CONFIG_IP_NF_FILTER=y
CONFIG_IP_NF_TARGET_REJECT=y
CONFIG_IP_NF_TARGET_LOG=y
CONFIG_NF_NAT=m
CONFIG_IP_NF_TARGET_MASQUERADE=m
CONFIG_IP_NF_TARGET_NETMAP=m
CONFIG_IP_NF_TARGET_REDIRECT=m
CONFIG_IP_NF_MANGLE=m
CONFIG_IP_NF_ARPTABLES=m
CONFIG_IP_NF_ARPFILTER=m
CONFIG_IP_NF_ARP_MANGLE=m
CONFIG_NF_CONNTRACK_IPV6=m
CONFIG_IP6_NF_QUEUE=m
CONFIG_IP6_NF_IPTABLES=m
CONFIG_IP6_NF_MATCH_AH=m
CONFIG_IP6_NF_MATCH_EUI64=m
CONFIG_IP6_NF_MATCH_FRAG=m
CONFIG_IP6_NF_MATCH_OPTS=m
CONFIG_IP6_NF_MATCH_HL=m
CONFIG_IP6_NF_MATCH_IPV6HEADER=m
CONFIG_IP6_NF_MATCH_MH=m
CONFIG_IP6_NF_MATCH_RT=m
CONFIG_IP6_NF_TARGET_LOG=m
CONFIG_IP6_NF_FILTER=m
CONFIG_IP6_NF_TARGET_REJECT=m
CONFIG_IP6_NF_MANGLE=m
CONFIG_ATM=m
CONFIG_PHONET=m
CONFIG_NET_SCHED=y
CONFIG_NET_SCH_HTB=y
CONFIG_NET_SCH_PRIO=y
CONFIG_NET_SCH_INGRESS=y
CONFIG_NET_CLS_U32=y
CONFIG_NET_CLS_CGROUP=y
CONFIG_NET_EMATCH=y
CONFIG_NET_EMATCH_U32=y
CONFIG_NET_CLS_ACT=y
CONFIG_NET_ACT_POLICE=y
CONFIG_NET_ACT_GACT=y
CONFIG_NET_ACT_MIRRED=y
CONFIG_DNS_RESOLVER=m
CONFIG_BT=m
CONFIG_BT_L2CAP=y
CONFIG_BT_SCO=y
CONFIG_BT_RFCOMM=m
CONFIG_BT_RFCOMM_TTY=y
CONFIG_BT_BNEP=m
CONFIG_BT_HIDP=m
CONFIG_BT_HCIBTUSB=m
CONFIG_BT_HCIUART=m
CONFIG_BT_HCIUART_H4=y
CONFIG_BT_HCIUART_BCSP=y
CONFIG_BT_HCIUART_LL=y
CONFIG_RFKILL=m
CONFIG_RFKILL_INPUT=y
CONFIG_DEVTMPFS=y
CONFIG_DEVTMPFS_MOUNT=y
# CONFIG_FIRMWARE_IN_KERNEL is not set
CONFIG_CONNECTOR=y
CONFIG_MTD=y
CONFIG_MTD_CMDLINE_PARTS=y
CONFIG_MTD_CHAR=m
CONFIG_MTD_BLOCK=y
CONFIG_MTD_DEFER_BLOCK_SCAN=y
CONFIG_MTD_COMPLEX_MAPPINGS=y
CONFIG_MTD_NAND_TEGRA=y
CONFIG_MTD_NAND_TEGRA_PAGE_CACHE=y
CONFIG_MTD_NAND_TEGRA_BUFFER_POOL=y
CONFIG_MTD_NAND_TEGRA_CQ_MODE=y
CONFIG_MTD_NAND=y
CONFIG_MTD_UBI=y
CONFIG_BLK_DEV_LOOP=y
CONFIG_SCSI=m
CONFIG_BLK_DEV_SD=m
CONFIG_BLK_DEV_SR=m
CONFIG_BLK_DEV_SR_VENDOR=y
CONFIG_CHR_DEV_SG=m
CONFIG_SCSI_MULTI_LUN=y
CONFIG_MD=y
CONFIG_BLK_DEV_DM=m
CONFIG_DM_CRYPT=m
CONFIG_DM_UEVENT=y
CONFIG_NETDEVICES=y
CONFIG_DUMMY=m
CONFIG_TUN=m
CONFIG_NET_ETHERNET=y
# CONFIG_NETDEV_1000 is not set
# CONFIG_NETDEV_10000 is not set
CONFIG_USB_USBNET=m
CONFIG_USB_NET_SMSC95XX=m
# CONFIG_USB_NET_NET1080 is not set
# CONFIG_USB_BELKIN is not set
# CONFIG_USB_ARMLINUX is not set
# CONFIG_USB_NET_ZAURUS is not set
CONFIG_USB_CDC_PHONET=m
CONFIG_USB_NET_SMSC95XX_VOH_MODE=y
# CONFIG_ATM_DRIVERS is not set
CONFIG_PPP=m
CONFIG_PPP_MULTILINK=y
CONFIG_PPP_FILTER=y
CONFIG_PPP_ASYNC=m
CONFIG_PPP_SYNC_TTY=m
CONFIG_PPP_DEFLATE=m
CONFIG_PPP_BSDCOMP=m
CONFIG_PPP_MPPE=m
CONFIG_PPPOE=m
CONFIG_PPPOATM=m
CONFIG_PPPOLAC=m
CONFIG_PPPOPNS=m
# CONFIG_INPUT_MOUSEDEV is not set
CONFIG_INPUT_EVDEV=y
CONFIG_INPUT_KEYRESET=y
# CONFIG_INPUT_KEYBOARD is not set
# CONFIG_INPUT_MOUSE is not set
CONFIG_INPUT_MISC=y
CONFIG_INPUT_UINPUT=y
CONFIG_INPUT_GPIO=y
# CONFIG_SERIO is not set
CONFIG_VT_HW_CONSOLE_BINDING=y
# CONFIG_LEGACY_PTYS is not set
CONFIG_SERIAL_8250=y
CONFIG_SERIAL_8250_CONSOLE=y
CONFIG_SERIAL_8250_NR_UARTS=2
CONFIG_SERIAL_8250_RUNTIME_UARTS=2
CONFIG_SERIAL_TEGRA=y
# CONFIG_HW_RANDOM is not set
CONFIG_I2C_CHARDEV=y
CONFIG_I2C_TEGRA=y
CONFIG_SPI=y
CONFIG_SPI_TEGRA=y
CONFIG_SPI_SLAVE_TEGRA=y
CONFIG_SPI_TEGRA_SLAVE_ASYNC=y
CONFIG_SPI_SPIDEV=y
CONFIG_GPIO_SYSFS=y
# CONFIG_HWMON is not set
CONFIG_MFD_TPS6586X=y
CONFIG_REGULATOR=y
CONFIG_REGULATOR_DUMMY=y
CONFIG_REGULATOR_FIXED_VOLTAGE=y
CONFIG_REGULATOR_VIRTUAL_CONSUMER=y
CONFIG_REGULATOR_TPS6586X=y
CONFIG_MEDIA_SUPPORT=y
CONFIG_VIDEO_DEV=y
# CONFIG_RC_CORE is not set
# CONFIG_TEGRA_RPC is not set
CONFIG_TEGRA_NVAVP=y
# CONFIG_TEGRA_DTV is not set
# CONFIG_V4L_USB_DRIVERS is not set
# CONFIG_RADIO_ADAPTERS is not set
# CONFIG_VGA_ARB is not set
CONFIG_VIDEO_OUTPUT_CONTROL=y
CONFIG_FB=y
CONFIG_TEGRA_GRHOST=y
CONFIG_TEGRA_DC=y
# CONFIG_TEGRA_DC_FBWIN is not set
CONFIG_SOUND=y
CONFIG_SND=y
CONFIG_SND_ALOOP=m
CONFIG_SND_USB_AUDIO=m
CONFIG_SND_SOC=y
CONFIG_SND_SOC_TEGRA=y
CONFIG_SND_SOC_TEGRA_P852=y
CONFIG_HID=m
CONFIG_HIDRAW=y
CONFIG_HIDRAW_FLOWCON=y
CONFIG_USB_HID=m
CONFIG_HID_PID=y
CONFIG_USB_HIDDEV=y
CONFIG_USB=y
CONFIG_USB_ANNOUNCE_NEW_DEVICES=y
CONFIG_USB_DEVICEFS=y
CONFIG_USB_EHCI_HCD=m
# CONFIG_USB_EHCI_TT_NEWSCHED is not set
CONFIG_USB_EHCI_TEGRA=y
CONFIG_USB_ACM=m
CONFIG_USB_WDM=m
CONFIG_USB_STORAGE=m
CONFIG_USB_LIBUSUAL=y
CONFIG_USB_SERIAL=m
CONFIG_USB_SERIAL_GENERIC=y
CONFIG_USB_SERIAL_PL2303=m
CONFIG_USB_SERIAL_OPTION=m
CONFIG_USB_GADGET=m
CONFIG_USB_DUMMY_HCD=m
CONFIG_USB_AUDIO=m
CONFIG_MMC=y
CONFIG_MMC_UNSAFE_RESUME=y
CONFIG_MMC_BKOPS=y
CONFIG_MMC_SDHCI=y
CONFIG_MMC_SDHCI_PLTFM=y
CONFIG_MMC_SDHCI_TEGRA=y
CONFIG_SWITCH=y
CONFIG_RTC_CLASS=y
CONFIG_RTC_DRV_TPS6586X=y
CONFIG_RTC_DRV_TEGRA=y
CONFIG_DMADEVICES=y
# CONFIG_IOMMU_SUPPORT is not set
CONFIG_EXT4_FS=y
CONFIG_EXT4_FS_SECURITY=y
# CONFIG_DNOTIFY is not set
CONFIG_QUOTA=y
# CONFIG_PRINT_QUOTA_WARNING is not set
CONFIG_QFMT_V2=y
CONFIG_AUTOFS4_FS=y
CONFIG_FUSE_FS=y
CONFIG_ISO9660_FS=m
CONFIG_JOLIET=y
CONFIG_UDF_FS=m
CONFIG_VFAT_FS=m
CONFIG_NTFS_FS=m
CONFIG_NTFS_RW=y
CONFIG_TMPFS=y
CONFIG_ECRYPT_FS=m
CONFIG_HFS_FS=m
CONFIG_HFSPLUS_FS=m
CONFIG_YAFFS_FS=m
# CONFIG_YAFFS_AUTO_YAFFS2 is not set
CONFIG_YAFFS_DISABLE_TAGS_ECC=y
# CONFIG_YAFFS_XATTR is not set
CONFIG_UBIFS_FS=y
CONFIG_UBIFS_FS_XATTR=y
CONFIG_SQUASHFS=m
# CONFIG_NETWORK_FILESYSTEMS is not set
CONFIG_PARTITION_ADVANCED=y
CONFIG_EFI_PARTITION=y
CONFIG_NLS_CODEPAGE_437=y
CONFIG_NLS_ISO8859_1=m
CONFIG_PRINTK_TIME=y
CONFIG_MAGIC_SYSRQ=y
CONFIG_DEBUG_FS=y
CONFIG_DETECT_HUNG_TASK=y
CONFIG_SCHEDSTATS=y
CONFIG_TIMER_STATS=y
# CONFIG_DEBUG_PREEMPT is not set
# CONFIG_DEBUG_BUGVERBOSE is not set
CONFIG_DEBUG_INFO=y
CONFIG_KEYS=y
CONFIG_CRYPTO_TWOFISH=y
# CONFIG_CRYPTO_ANSI_CPRNG is not set
CONFIG_CRC_CCITT=y
```

## kernel/drivers/budet/Kconfig
```kconfig
#
# devone configuration
#

config ADA_BUDET_DETECT
	bool "ADA BU-DET intterupt detection"
	default n
	depends on SUSPEND
	---help---
	  Enable ADA BU-DET interrupt handling

choice
	prompt "ADA BU-DET Resume mode"
	depends on ADA_BUDET_DETECT
	default ADA_BUDET_RESUME_MODE_AFTER_REINIT

	config ADA_BUDET_RESUME_MODE_BEFORE_TRISTATE
		bool "Before tristate"

	config ADA_BUDET_RESUME_MODE_AFTER_TRISTATE
		bool "After tristate"

	config ADA_BUDET_RESUME_MODE_AFTER_PREPARE_TO_REINIT
		bool "After prepare_to_reinit"

	config ADA_BUDET_RESUME_MODE_AFTER_REINIT
		bool "After reinit"
endchoice
```

## kernel/drivers/misc/lites/Kconfig
```kconfig
menu "lites"
config LITES
	tristate "lites driver"
	help
	  Say y here if you use LITES.

config LITES_OUTLOG_LEVEL
	int "default print log level"
	default -1
	help
	  Set default print log level.

endmenu
```

## kernel/drivers/misc/ti-st/Kconfig
```kconfig
#
# TI's shared transport line discipline and the protocol
# drivers (BT, FM and GPS)
#
menu "Texas Instruments shared transport line discipline"
config TI_ST
	tristate "Shared transport core driver"
	depends on NET && GPIOLIB
	select FW_LOADER
	help
	  This enables the shared transport core driver for TI
	  BT / FM and GPS combo chips. This enables protocol drivers
	  to register themselves with core and send data, the responses
	  are returned to relevant protocol drivers based on their
	  packet types.

config ST_GPS
	tristate "gps driver for ST"
	select TI_ST
	help
	  This enables the GPS driver for TI WL128x BT/FM/GPS combo devices.
	  It will provide a character device for the TI GPS host software to
	  access the GPS core on the WL128x.

# FUJITSU TEN:2012-08-09 BT/GPS debug config add. end
config TI_ST_BT_EN_INVERT
	bool "INVERT BT_EN enable state for BB/1S"
	default n
	help
	  Say Y here if you have INVERT BT_EN enable state
	  for BB/1S.

	  If unsure, say N.
# FUJITSU TEN:2012-08-09 BT/GPS debug config add. end

# FUJITSU-TEN:2012-09-07 Support_BuDet start
config TI_FASTBOOT
	bool "Enable BuDet logics for TI WiLink"
	default y
	help
	  This enables Bu-Det/ACC Interrupt spesific logics for TI WiLink.

config TI_ST_DEBUG_LOG
	bool "Enable ti-st DEBUG log"
	default n
	
config TI_ST_TRACE_LOG
	bool "Enable ti-st TRACE log"
	default n

# FUJITSU-TEN:2012-09-07 Support_BuDet end

# FUJITSU-TEN:2013-06-12 config U-APSD start
config TI_UAPSD
	bool "Enable UAPSD"
	default n
	help
	  This enables UAPSD function.
# FUJITSU-TEN:2013-06-12 config U-APSD end

endmenu
```
